## src/arch/arm/mach-mx27/Kconfig
```kconfig
menu "MX27 Options"
	depends on ARCH_MX27

config MACH_MX27ADS
	bool "Support MX27ADS platforms"
	default y
	help
	  Include support for MX27ADS platform. This includes specific
	  configurations for the board and its peripherals.

config MACH_MX27_MDK27V0
	bool "Support MX27 MDK27V0 platforms"
	default n
	select MXC_POWER_CONTROL
	help
	  Include support for MX27 MDK27V0 platform. This includes specific
	  configurations for the board and its peripherals.

config MACH_MX27_MDK27V1
	bool "Support MX27 MDK27V1 platforms"
	default n
	select MACH_MX27_MDK27V0
	help
	  Include support for MX27 MDK27V1 platform. This includes specific
	  configurations for the board and its peripherals.

config MACH_MX27_SYP
	bool "Support MX27 SYP platforms"
	default n
	select MACH_MX27_MDK27V1
	help
	  Include support for MX27 SYP platform. This includes specific
	  configurations for the board and its peripherals.

config MACH_MX27_TUOSI
	bool "Support MX27 TUOSI platforms"
	default n
	select MACH_MX27_MDK27V1
	help
	  Include support for MX27 TUOSI platform. This includes specific
	  configurations for the board and its peripherals.

config MACH_MX27_MPK271
	bool "Support MX27 MPK271 platforms"
	default n
	select MACH_MX27_MDK27V1
	help
	  Include support for MX27 MPK271 platform. This includes specific
	  configurations for the board and its peripherals.

config MACH_MX27_MPK272
	bool "Support MX27 MPK272 platforms"
	default n
	select MACH_MX27_MPK271
	help
	  Include support for MX27 MPK272 platform. This includes specific
	  configurations for the board and its peripherals.

config MACH_MX27_TUTK
	bool "Support MX27 TUTK platforms"
	default n
	select MACH_MX27_MPK271
	help
	  Include support for MX27 TUTK platform. This includes specific
	  configurations for the board and its peripherals.

config ISP1504_MXC
	tristate "ISP1504 transceiver support"
	select ISP1504_MXC_OTG if USB_GADGET && USB_EHCI_HCD && USB_OTG
	help
	  Support for the ISP1504 USB transceiver on MXC platforms.

config ISP1504_MXC_OTG
	tristate
	help
	  Support for USB OTG using the ISP1504 transceiver on MXC platforms.

config ISP1301_MXC
	bool
	select I2C_MXC

menu "Device options"

config I2C_MXC_SELECT1
	bool "Enable I2C1 module"
	default y
	depends on I2C_MXC
	help
	  Enable MX31 I2C1 module.

config I2C_MXC_SELECT2
	bool "Enable I2C2 module"
	default n
	depends on I2C_MXC
	help
	  Enable MX31 I2C2 module.

config MXC_POWER_CONTROL
	bool "Support power control to external modules"
	default n
	help
	  Support the control of power to external modules.
endmenu

endmenu
```

## src/drivers/media/video/mxc/capture/Kconfig
```kconfig
if VIDEO_MXC_CAMERA

menu "MXC Camera/V4L2 PRP Features support"
config VIDEO_MXC_IPU_CAMERA
	bool
	depends on VIDEO_MXC_CAMERA && MXC_IPU
	default y

config VIDEO_MXC_EMMA_CAMERA
	tristate "MX27 eMMA support"
	depends on VIDEO_MXC_CAMERA && MXC_EMMA && FB_MXC_SYNC_PANEL && (MXC_CAMERA_MICRON111 || MXC_CAMERA_MC521DA || MXC_CAMERA_OV2640 || MXC_CAMERA_HI253 || MXC_CAMERA_TVP5150 || MXC_CAMERA_ADV7180)
	select VIDEO_MXC_OPL
	default y

config VIDEO_MXC_CSI_DMA
	bool "CSI-DMA Still Image Capture support"
	depends on VIDEO_MXC_EMMA_CAMERA
	default n
	---help---
	  Use CSI-DMA method instead of CSI-PrP link to capture still image. This allows
	  to use less physical contiguous memory to capture big resolution still image. But
	  with this method the CSC (Color Space Conversion) and resize are not supported.
	  If unsure, say N.

choice
	prompt "Select Camera"
	default MXC_CAMERA_OV2640
	depends on (VIDEO_MXC_CAMERA && I2C_MXC)

config MXC_CAMERA_MC521DA
	tristate "Magnachip mc521da camera support"
	---help---
	  If you plan to use the mc521da Camera with your MXC system, say Y here.

config MXC_CAMERA_MICRON111
	tristate "Micron mt9v111 camera support"
	---help---
	  If you plan to use the mt9v111 Camera with your MXC system, say Y here.

config MXC_CAMERA_OV2640
	tristate "OmniVision ov2640 camera support"
	---help---
	  If you plan to use the ov2640 Camera with your MXC system, say Y here.

config MXC_CAMERA_HI253
	tristate "TRULY CM8257 camera support"
	---help---
	  If you plan to use the CM8257 Camera with your MXC system, say Y here.

config MXC_CAMERA_TVP5150
	tristate "TVP5150 TVin support"
	---help---
	  If you plan to use the TVP5150 TVin with your MXC system, say Y here.

config MXC_CAMERA_ADV7180
	tristate "ADV7180 TVin support"
	---help---
	  If you plan to use the ADV7180 TVin with your MXC system, say Y here.

config MXC_CAMERA_TW2835
	tristate "TW2835 TVin support"
	---help---
	  If you plan to use the TW2835 TVin with your MXC system, say Y here.
endchoice

config MXC_IPU_PRP_VF_SDC
	tristate "Pre-Processor VF SDC library"
	depends on (VIDEO_MXC_IPU_CAMERA && FB_MXC_SYNC_PANEL && (MXC_CAMERA_MC521DA || MXC_CAMERA_MICRON111 || MXC_CAMERA_OV2640))
	default y
	---help---
	  Use case PRP_VF_SDC:
		Preprocessing image from smart sensor for viewfinder and
		displaying it on synchronous display with SDC use case.
		If SDC BG is selected, Rotation will not be supported.
		CSI -> IC (PRP VF) -> MEM
		MEM -> IC (ROT) -> MEM
		MEM -> SDC (FG/BG)

config MXC_IPU_PRP_VF_ADC
	tristate "Pre-Processor VF ADC library"
	depends on (VIDEO_MXC_IPU_CAMERA && FB_MXC_ASYNC_PANEL && (MXC_CAMERA_MC521DA || MXC_CAMERA_MICRON111 || MXC_CAMERA_OV2640))
	default y
	---help---
	  Use case PRP_VF_ADC:
		Preprocessing image from smart sensor for viewfinder and
		displaying it on asynchronous display.
		CSI -> IC (PRP VF) -> ADC2

config MXC_IPU_PRP_ENC
	tristate "Pre-processor Encoder library"
	depends on (VIDEO_MXC_IPU_CAMERA && (MXC_CAMERA_MC521DA || MXC_CAMERA_MICRON111 || MXC_CAMERA_OV2640))
	default y
	---help---
	  Use case PRP_ENC:
		Preprocessing image from smart sensor for encoder.
		CSI -> IC (PRP ENC) -> MEM

endmenu

endif
```

## src/drivers/mxc/ssi/Kconfig
```kconfig
#
# SPI device configuration
#

menu "MXC SSI support"

config MXC_SSI
	tristate "SSI support"
	---help---
	  Say Y to get the SSI services API available on MXC platform. 

config MXC_SSI_AC97
	tristate "SSI AC97 support"
	depends on MXC_SSI
	---help---
	  Say Y to get the SSI AC97 support on MXC platform. 

endmenu
```
